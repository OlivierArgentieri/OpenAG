#ifndef S8SENSAIR_H
#define S8SENSAIR_H

#include <WString.h>
#include "HardwareSerial.h"

#include "../utils/WMLog.h"
#include "../utils/WMUtils.h"

#include "../base/BaseComponent.h"
#include "../base/IPrometheusable.h"

#define S8_RX_PIN 13         // Rx pin which the S8 Tx pin is attached to (change if it is needed)
#define S8_TX_PIN 15         // Tx pin which the S8 Rx pin is attached to (change if it is needed)
#define S8_BAUDRATE 9600    // Baudrate of the S8 UART interface (default is 9600) (change if it is needed)

const byte RXD2 = 16;
const byte TXD2 = 17;
//Commandes senseair
const byte CO2Command[] = {0xFE, 0X04, 0X00, 0X03, 0X00, 0X01, 0XD5, 0XC5};
const byte MeterStatus[] = {0xFE, 0X04, 0X00, 0X00, 0X00, 0X01, 0X25, 0XC5};
const byte Acknowledgement[] = {0xFE, 0X03, 0X00, 0X00, 0X00, 0X01, 0X90, 0X05};
const byte ABCperiod[] = {0xFE, 0X03, 0X00, 0X1F, 0X00, 0X01, 0XA1, 0XC3};
byte Response[] = {0, 0, 0, 0, 0, 0, 0};
int nb;
unsigned int valCO2;
unsigned int valStatus;
unsigned int crc, crcRead;

/* Table of CRC values for high–order byte */
static const byte auchCRCHi[] = {
  0x00, 0xC1, 0x81, 0x40, 0x01, 0xC0, 0x80, 0x41, 0x01, 0xC0, 0x80, 0x41, 0x00, 0xC1, 0x81,
  0x40, 0x01, 0xC0, 0x80, 0x41, 0x00, 0xC1, 0x81, 0x40, 0x00, 0xC1, 0x81, 0x40, 0x01, 0xC0,
  0x80, 0x41, 0x01, 0xC0, 0x80, 0x41, 0x00, 0xC1, 0x81, 0x40, 0x00, 0xC1, 0x81, 0x40, 0x01,
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  0x00, 0xC1, 0x81, 0x40, 0x01, 0xC0, 0x80, 0x41, 0x01, 0xC0, 0x80, 0x41, 0x00, 0xC1, 0x81,
  0x40
} ;

/* Table of CRC values for low–order byte */
static const byte auchCRCLo[] = {
  0x00, 0xC0, 0xC1, 0x01, 0xC3, 0x03, 0x02, 0xC2, 0xC6, 0x06, 0x07, 0xC7, 0x05, 0xC5, 0xC4,
  0x04, 0xCC, 0x0C, 0x0D, 0xCD, 0x0F, 0xCF, 0xCE, 0x0E, 0x0A, 0xCA, 0xCB, 0x0B, 0xC9, 0x09,
  0x08, 0xC8, 0xD8, 0x18, 0x19, 0xD9, 0x1B, 0xDB, 0xDA, 0x1A, 0x1E, 0xDE, 0xDF, 0x1F, 0xDD,
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  0x44, 0x84, 0x85, 0x45, 0x87, 0x47, 0x46, 0x86, 0x82, 0x42, 0x43, 0x83, 0x41, 0x81, 0x80,
  0x40
};

class S8Sensair : public BaseComponent, public IPrometheusable {
  public:
    /**
     * constructor
    */
    S8Sensair() = default;
    S8Sensair(const S8Sensair&) = delete;
    S8Sensair& operator=(const S8Sensair&) = delete;

  public:
    /**
     * Overrided Methods 
    */
    void Setup() override;
    void Loop(const float dt) override;
    String GetPrometheusData() const override;
    String UniqueName() const override { return "S8Sensair"; }

  public:
    /**
     * public methods
    */

    /** Get CO2 value as string */
    String GetCO2() const { return error ? "0" : lastValue; }

  private:
    /**
     * private methods
    */

    /** modbus_CRC16 */
    unsigned int modbus_CRC16 (byte * puchMsg, unsigned int usDataLen);

  private:
    /**
     * private members
    */

    // TODO macro for this
    /** serial object */
    //Use UART channel 2 FOR GPIO 16/17 on esp32 wroom
    HardwareSerial S8_serial = HardwareSerial(2); 

    /** last sensor value */
    String lastValue = "";

    /** error flag */
    bool error = false;
};

inline void S8Sensair::Setup() {
  S8_serial.begin(9600, SERIAL_8N1, RXD2, TXD2);  // D6,D7
}

inline void S8Sensair::Loop(const float dt) {
 String s = "";
  //meter status a senseair S8
  memset(Response, 0, 7);
  S8_serial.write(MeterStatus, 8);
  nb = S8_serial.readBytes(Response, 7);
  while (S8_serial.available()) S8_serial.read();//vidage du buffer
  if (nb == 7) {
    if (crc == crcRead) {
      if (Response[0] == 254) {
        valStatus = Response[3] * 256 + Response[4];
      }
      else s = "err rs232 Status: premier octet différent de 254 " + (String)Response[0];
    }
    else s = "err rs232 Valeur crc";
  }
  else s = "err rs232 Status: nombre d octets retourné différent de 7: " + (String)nb;
  
  if (s != "") {
    LOG_ERROR(s);
    error = true;
    return;
  }
  
  //demande CO2 a sensair S8
  memset(Response, 0, 7); //mettre 7 x 0 dans le tableau Response
  S8_serial.write(CO2Command, 8);
  nb = S8_serial.readBytes(Response, 7);
  while (S8_serial.available()) S8_serial.read();//vidage du buffer
  crc = modbus_CRC16(Response, 5);
  crcRead = (((unsigned int)Response[6]) << 8) + (unsigned int)Response[5];
  if (nb == 7) {
    if (crc == crcRead) {
      if (Response[0] == 254) {
        valCO2 = Response[3] * 256 + Response[4];
      }
      else s = "err rs232 Valeur CO2: premier octet différent de 254 " + (String)Response[0];
    }
    else s = "err rs232 Valeur crc";
  }
  else s = "err rs232 Valeur CO2: nombre d octets retourné différent de 7: " + (String)nb;
  if (valStatus > 0) s = "erreur status: " + (String)valStatus;

  if (s != "") {
    LOG_ERROR(s);
    error = true;
    return;
  }
  //compilation des erreurs
  lastValue =(String)valCO2;
}

inline unsigned int S8Sensair::modbus_CRC16 (byte * puchMsg, unsigned int usDataLen ) {
  /*
      puchMsg  -> message to calculate CRC upon
      usDataLen -> quantity of bytes in message
  */
  byte uchCRCHi = 0xFF ;             /* high byte of CRC initialized */
  byte uchCRCLo = 0xFF ;             /* low byte of CRC initialized */
  unsigned int uIndex ;                     /* will index into CRC lookup table */

  while (usDataLen--)                   /* pass through message buffer */
  {
    uIndex = uchCRCLo ^ *puchMsg++ ;  /* calculate the CRC */
    uchCRCLo = uchCRCHi ^ auchCRCHi[uIndex] ;
    uchCRCHi = auchCRCLo[uIndex] ;
  }
  return (uchCRCHi << 8 | uchCRCLo) ;
}

inline String S8Sensair::GetPrometheusData() const {
  if (error) {
      return this->GeneratePrometheusData("C02", "0", "eCO2");
  }
  return this->GeneratePrometheusData("C02", lastValue, "eCO2");
}
#endif
